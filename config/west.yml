## config/west.yml
```yaml
manifest:
  remotes:
    - name: zmkfirmware
      url-base: https://github.com/zmkfirmware
    - name: ZitaoTech
      url-base: https://github.com/tomylin890
  projects:
    - name: zmk
      remote: ZitaoTech
      revision: uconsole-scroll
      import: app/west.yml
  self:
    path: config
```
